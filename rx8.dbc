VERSION ""

NS_ :

BS_:

BU_: XXX

BO_ 201 PCM: 8 XXX
 SG_ RPM : 0|12@0+ (1,0) [0|13000] "rpm" XXX

CM_ SG_ 201 RPM "Cannot work out conversion factor atm";
